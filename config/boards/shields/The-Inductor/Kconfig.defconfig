## config/boards/shields/The_Inductor/Kconfig.defconfig
```kconfig
if THE_INDUCTOR

config ZMK_KEYBOARD_NAME
    default "The Inductor"

config I2C
    default y

config GPIO
    default y

config ZMK_USB_LOGGING
    default y

config ZMK_USB 
    default y

config ZMK_KSCAN_MATRIX_POLLING
    default y

config LOG_PROCESS_THREAD_STARTUP_DELAY_MS
    default 2500

config GPIO_LOG_LEVEL_DBG
    default y

endif
```
